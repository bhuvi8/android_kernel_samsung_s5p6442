## arch/arm/mach-s5p6442/Kconfig
```kconfig
# arch/arm/mach-s5p6442/Kconfig
#
# Copyright (c) 2010 Samsung Electronics Co., Ltd.
#		http://www.samsung.com/
#
# Licensed under GPLv2

# Configuration options for the S5P6442

if ARCH_S5P6442

config CPU_S5P6442
	bool "Enable S5P6442 CPU support"
	select S3C_PL330_DMA
	select S5P_PM if PM
	select S5P_SLEEP if PM
	select S5P_HRT
	select S5P_EXT_INT
	help
	  Enable S5P6442 CPU support

config S5P6442_SETUP_I2C1
	bool "S5P6442 I2C Bus 1"
	help
	  Common setup code for i2c bus 1.

config S5P6442_SETUP_I2C2
	bool "S5P6442 I2C Bus 2"
	help
	  Common setup code for i2c bus 2.

config S5P6442_SETUP_FB_24BPP
	bool "S5P6442 Framebuffer"
	help
          Common setup code for S5P6442 with an 24bpp RGB display helper.

config S5P6442_SETUP_KEYPAD
	bool "S5P6442 Keypad"
	help
	  Common setup code for keypad.

config S5P6442_SETUP_SDHCI
        bool "S5P6442 SDHCI"
        select S5P6442_SETUP_SDHCI_GPIO
        help
          Internal helper functions for S5P6442 based SDHCI systems

config S5P6442_SETUP_FIMC
	bool "S5P6442 FIMC"
	help
	  Common setup code for the camera interfaces.

config S5P6442_SETUP_USB_PHY
	bool "S5P6442 USB PHY"
	help
	  Common setup code for USB PHY controller

menu "S5P6442 Machines"

config MACH_SMDK6442
	bool "SMDK6442"
	select CPU_S5P6442
	select S3C_DEV_WDT
	help
	  Machine support for Samsung SMDK6442
	  
config MACH_APOLLO
	bool "Samsung Galaxy i580x (APOLLO)"
	select CPU_S5P6442
	select S5P_GPIO_INT
	select S3C_DEV_FB
	select S3C_DEV_I2C1
	select S3C_DEV_I2C2
	select S3C_DEV_RTC
	select S3C_DEV_WDT
	select S3C_DEV_HSMMC
	select S3C_DEV_HSMMC1
	select S3C_DEV_HSMMC2
#	select S5P_DEV_ONENAND
	select S3C_DEV_USB_HSOTG
	select S5P_DEV_FIMC0
	select S5P_DEV_FIMC1
	select S5P_DEV_FIMC2
	select S5P_DEV_MFC
	select S5P_DEV_JPEG
	select SAMSUNG_DEV_ADC
	select SAMSUNG_DEV_BACKLIGHT
	select SAMSUNG_DEV_PWM
	select SAMSUNG_DEV_TS
	select SAMSUNG_DEV_KEYPAD
	select NEED_MACH_MEMORY_H
	help
	  Machine support for the Samsung Galaxy Apollo

endmenu

endif
```
